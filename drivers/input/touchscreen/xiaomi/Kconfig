## drivers/input/touchscreen/xiaomi/Kconfig
```kconfig
source "drivers/input/touchscreen/xiaomi/synaptics_dsx_force/Kconfig"
source "drivers/input/touchscreen/xiaomi/fts_521/Kconfig"
source "drivers/input/touchscreen/xiaomi/nt36xxx_mi/Kconfig"
source "drivers/input/touchscreen/xiaomi/ft5x46/Kconfig"
source "drivers/input/touchscreen/xiaomi/focaltech_touch_mi/Kconfig"

config INPUT_PRESS_NDT
	bool "ndt"
	default n
	depends on I2C
	help
	  Say Y here if you have a press ic ndt.

config INPUT_PRESS_NDT_F60
	bool "ndt f60"
	depends on INPUT_PRESS_NDT
	help
	  Say Y here if you have a press ic ndt.

config INPUT_PRESS_NDT_M65
	bool "ndt m65"
	depends on INPUT_PRESS_NDT
	help
	  Say Y here if you have a press ic ndt.

config TOUCHSCREEN_ATMEL_MXT_MI
	tristate "Atmel mXT I2C Touchscreen"
	depends on I2C
	select FW_LOADER
	help
	  Say Y here if you have Atmel mXT series I2C touchscreen,
	  such as AT42QT602240/ATMXT224, connected to your system.

	  If unsure, say N.

	  To compile this driver as a module, choose M here: the
	  module will be called atmel_mxt_ts.
```

## drivers/input/touchscreen/xiaomi/focaltech_touch_mi/Kconfig
```kconfig
#
# Focaltech Touchscreen driver configuration
#

config TOUCHSCREEN_FTS_MI
        bool "Focaltech Touchscreen"
		depends on I2C
		default n
		help
		  Say Y here if you have Focaltech touch panel.
		  If unsure, say N.

config TOUCHSCREEN_FTS_MI_POWER_SUPPLY
        bool "USB Power Supply"
        default n
        help
            Say y here if phone type is perseus
            If unsure, say N

config TOUCHSCREEN_FTS_MI_DIRECTORY
    string "Focaltech ts directory name"
    default "focaltech_touch"
    depends on TOUCHSCREEN_FTS_MI
```

## drivers/input/touchscreen/xiaomi/nt36xxx_mi/Kconfig
```kconfig
#
# Novatek NT36xxx touchscreen driver configuration
#
config TOUCHSCREEN_NT36XXX_MI
	bool "Novatek NT36XXX MI"
	default n
	help
	  Say Y here if you have a Novatek NT36xxx touchscreen connected
	  to your system.

	  If unsure, say N.
```
