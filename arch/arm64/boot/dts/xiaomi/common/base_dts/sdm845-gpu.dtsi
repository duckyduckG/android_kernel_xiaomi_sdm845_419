&soc {
    /delete-node/ gpu-bw-tbl;
    gpu_bw_tbl: gpu-bw-tbl {
        compatible = "operating-points-v2";
        /* BW_OPP_ENTRY(   0, 4);    0 MB/s */
        /* BW_OPP_ENTRY( 100, 4);  381 MB/s */
        /* BW_OPP_ENTRY( 150, 4);  572 MB/s */
        /* BW_OPP_ENTRY( 200, 4);  762 MB/s */
        /* BW_OPP_ENTRY( 300, 4); 1144 MB/s */
        BW_OPP_ENTRY( 412, 4); /* 1571 MB/s */
        BW_OPP_ENTRY( 547, 4); /* 2086 MB/s */
        BW_OPP_ENTRY( 681, 4); /* 2597 MB/s */
        BW_OPP_ENTRY( 768, 4); /* 2929 MB/s */
        BW_OPP_ENTRY(1017, 4); /* 3879 MB/s */
        BW_OPP_ENTRY(1296, 4); /* 4943 MB/s */
        BW_OPP_ENTRY(1555, 4); /* 5931 MB/s */
        BW_OPP_ENTRY(1804, 4); /* 6881 MB/s */
    };
};
